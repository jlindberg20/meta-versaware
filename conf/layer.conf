## conf/layer.conf
```bitbake
# We have a conf and classes directory, add to BBPATH
BBPATH .= ":${LAYERDIR}"

# We have a packages directory, add to BBFILES
BBFILES += "${LAYERDIR}/recipes-*/*/*.bb \
            ${LAYERDIR}/recipes-*/*/*.bbappend"

BBFILE_COLLECTIONS += "versaware"
BBFILE_PATTERN_versaware := "^${LAYERDIR}/"
BBFILE_PRIORITY_versaware = "9"

LAYERSERIES_COMPAT_versaware = "dunfell"
```
